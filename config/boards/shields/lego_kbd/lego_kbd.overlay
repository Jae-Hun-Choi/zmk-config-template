#include <dt-bindings/zmk/matrix_transform.h>
#include <dt-bindings/gpio/gpio.h>

/ {
    chosen {
        zmk,kscan = &kscan0;
    };

    kscan0: kscan_0 {
        compatible = "zmk,kscan-gpio-matrix";
        label = "KSCAN";
        diode-direction = "col2row"; // 다이오드 방향 (보통 col2row)

        // 작성자님 회로도 보고 핀 번호 수정 필수!
        row-gpios
            = <&gpio0 31 (GPIO_ACTIVE_HIGH | GPIO_PULL_DOWN)> // Row 0
            , <&gpio0 29 (GPIO_ACTIVE_HIGH | GPIO_PULL_DOWN)> // Row 1
            , <&gpio0  2 (GPIO_ACTIVE_HIGH | GPIO_PULL_DOWN)> // Row 2
            , <&gpio1 15 (GPIO_ACTIVE_HIGH | GPIO_PULL_DOWN)> // Row 3
            , <&gpio1 11 (GPIO_ACTIVE_HIGH | GPIO_PULL_COWN)>;// Row 4

        col-gpios
            = <&gpio0  6 GPIO_ACTIVE_HIGH> // Col 0
            , <&gpio0  8 GPIO_ACTIVE_HIGH> // Col 1
            , <&gpio0 22 GPIO_ACTIVE_HIGH> // Col 2
            , <&gpio0 24 GPIO_ACTIVE_HIGH> // Col 3
            , <&gpio1  0 GPIO_ACTIVE_HIGH> // Col 4
            , <&gpio0 11 GPIO_ACTIVE_HIGH> // Col 5 
            , <&gpio1  4 GPIO_ACTIVE_HIGH> // Col 6 
            , <&gpio1  6 GPIO_ACTIVE_HIGH> // Col 7
            , <&gpio1  1 GPIO_ACTIVE_HIGH> // Col 8
            , <&gpio1  2 GPIO_ACTIVE_HIGH> // Col 9
            , <&gpio1  7 GPIO_ACTIVE_HIGH> // Col 10 
            , <&gpio0 10 GPIO_ACTIVE_HIGH> // Col 11 
            , <&gpio0  9 GPIO_ACTIVE_HIGH>;// Col 12 

    };
};
